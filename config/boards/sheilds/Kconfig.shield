## config/boards/sheilds/Kconfig.shield
```kconfig
# No whitespace after the comma or in your part name!
config SHIELD_LUCA_LEFT
    def_bool $(shields_list_contains,luca_left)

# No whitespace after the comma or in your part name!
config SHIELD_LUCA_RIGHT
    def_bool $(shields_list_contains,luca_right)
```

## config/boards/shields/luca/Kconfig.shield
```kconfig
config SHIELD_LUCA_LEFT
    def_bool $(shields_list_contains,luca_left)

config SHIELD_LUCA_RIGHT
    def_bool $(shields_list_contains,luca_right)

config SHIELD_LUCA_DONGLE
    def_bool $(shields_list_contains,luca_dongle)
```

## config/west.yml
```yaml
manifest:
  remotes:
    - name: zmkfirmware
      url-base: https://github.com/zmkfirmware
    - name: badjeff
      url-base: https://github.com/badjeff
  projects:
    - name: zmk
      remote: zmkfirmware
      revision: 19582174f3a446a07d40f479020b4ebb1aad8ddb
      import: app/west.yml
    - name: zmk-pmw3610-driver
      remote: badjeff
      revision: main
  self:
    path: config
```
